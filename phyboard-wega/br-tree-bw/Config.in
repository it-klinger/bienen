## phyboard-wega/br-tree-bw/Config.in
```kconfig
source "$BR2_EXTERNAL_BW_PATH/package/bienen/Config.in"
source "$BR2_EXTERNAL_BW_PATH/package/pqbienen/Config.in"
```

## phyboard-wega/br-tree-bw/configs/wega_bw_defconfig
```kconfig
BR2_arm=y
BR2_cortex_a8=y
BR2_DL_DIR="/opt/buildroot"
BR2_HOST_DIR="/opt/arm-br-bw-cortexa8-glibc"
BR2_GLOBAL_PATCH_DIR="$(BR2_EXTERNAL_BW_PATH)/patches/"
BR2_TOOLCHAIN_BUILDROOT_GLIBC=y
BR2_KERNEL_HEADERS_4_14=y
BR2_TOOLCHAIN_BUILDROOT_CXX=y
BR2_PACKAGE_HOST_GDB=y
BR2_GDB_VERSION_7_12=y
BR2_TARGET_GENERIC_HOSTNAME="bw"
BR2_TARGET_GENERIC_ISSUE="Welcome to Bienenwaage"
BR2_SYSTEM_BIN_SH_BASH=y
BR2_TARGET_GENERIC_GETTY_PORT="ttyS0"
BR2_SYSTEM_DHCP="eth0"
BR2_ROOTFS_OVERLAY="$(BR2_EXTERNAL_BW_PATH)/board/wega/overlay/"
BR2_ROOTFS_POST_IMAGE_SCRIPT="$(BR2_EXTERNAL_BW_PATH)/board/wega/post-image.sh"
BR2_LINUX_KERNEL=y
BR2_LINUX_KERNEL_DEFCONFIG="wega_bw"
BR2_LINUX_KERNEL_DTS_SUPPORT=y
BR2_LINUX_KERNEL_INTREE_DTS_NAME="am335x-wega-bw"
BR2_PACKAGE_LINUX_TOOLS_GPIO=y
BR2_PACKAGE_LINUX_TOOLS_IIO=y
BR2_PACKAGE_LINUX_TOOLS_PERF=y
BR2_PACKAGE_LINUX_TOOLS_PERF_TUI=y
BR2_PACKAGE_BUSYBOX_SHOW_OTHERS=y
BR2_PACKAGE_GDB=y
BR2_PACKAGE_LSOF=y
BR2_PACKAGE_LTRACE=y
BR2_PACKAGE_RT_TESTS=y
BR2_PACKAGE_STRACE=y
BR2_PACKAGE_STRESS=y
BR2_PACKAGE_STRESS_NG=y
BR2_PACKAGE_TRACE_CMD=y
BR2_PACKAGE_VALGRIND=y
BR2_PACKAGE_DIFFUTILS=y
BR2_PACKAGE_FINDUTILS=y
BR2_PACKAGE_GIT=y
BR2_PACKAGE_GREP=y
BR2_PACKAGE_TREE=y
BR2_PACKAGE_MTD=y
BR2_PACKAGE_GNUPLOT=y
BR2_PACKAGE_I2C_TOOLS=y
BR2_PACKAGE_RNG_TOOLS=y
BR2_PACKAGE_RTC_TOOLS=y
BR2_PACKAGE_SPI_TOOLS=y
BR2_PACKAGE_UBOOT_TOOLS=y
BR2_PACKAGE_LIBPQXX=y
BR2_PACKAGE_POSTGRESQL=y
BR2_PACKAGE_LIBCONFIG=y
BR2_PACKAGE_DTC=y
BR2_PACKAGE_DTC_PROGRAMS=y
BR2_PACKAGE_LIBAIO=y
BR2_PACKAGE_LIBIIO=y
BR2_PACKAGE_ELFUTILS_PROGS=y
BR2_PACKAGE_MSMTP=y
BR2_PACKAGE_MUTT=y
BR2_PACKAGE_MUTT_IMAP=y
BR2_PACKAGE_MUTT_POP3=y
BR2_PACKAGE_EMPTY=y
BR2_PACKAGE_CAN_UTILS=y
BR2_PACKAGE_NETCAT=y
BR2_PACKAGE_NTP=y
# BR2_PACKAGE_NTP_NTPD is not set
BR2_PACKAGE_NTP_NTPDATE=y
BR2_PACKAGE_OPENSSH=y
BR2_PACKAGE_RSYNC=y
BR2_PACKAGE_FILE=y
BR2_PACKAGE_SCREEN=y
BR2_PACKAGE_COREUTILS=y
BR2_PACKAGE_HTOP=y
BR2_PACKAGE_PROCPS_NG=y
BR2_PACKAGE_PSMISC=y
BR2_PACKAGE_UTIL_LINUX=y
BR2_PACKAGE_UTIL_LINUX_BINARIES=y
BR2_PACKAGE_UTIL_LINUX_SCHEDUTILS=y
BR2_PACKAGE_LESS=y
BR2_PACKAGE_VIM=y
BR2_TARGET_BAREBOX=y
BR2_TARGET_BAREBOX_BOARD_DEFCONFIG="am335x"
BR2_TARGET_BAREBOX_IMAGE_FILE="images/barebox-am33xx-phytec-phycore.img"
BR2_TARGET_BAREBOX_AUX=y
BR2_TARGET_BAREBOX_AUX_BOARD_DEFCONFIG="am335x_mlo"
BR2_TARGET_BAREBOX_AUX_IMAGE_FILE="images/barebox-am33xx-phytec-phycore-mlo-256mb.img"
BR2_PACKAGE_HOST_E2FSPROGS=y
BR2_PACKAGE_BIENEN=y
```

## phyboard-wega/br-tree-bw/package/bienen/Config.in
```kconfig
config BR2_PACKAGE_BIENEN
	bool "bienen"
	help
	  This is the bee weighting application for detection swarms,
	  hungry bees and honey robbery.
```

## phyboard-wega/br-tree-bw/package/pqbienen/Config.in
```kconfig
config BR2_PACKAGE_PQBIENEN
	bool "postgresql-database for bienen"
	help
	  This is the database for the bienen project
```
